#include "systick_cfg.h"
#include "led_cfg.h"
//---定时器全局变量
SysTick_HandlerType g_SysTick =
{
	.tickModel = 0,
	.usXBaseNum = 0,
	.usXBaseCount = 0,
	.msX1Count = 0,
	.msX10Count = 0,
	.sX1Count=0,
};
pSysTick_HandlerType pSysTick = &g_SysTick;

///////////////////////////////////////////////////////////////////////////////
//////函	   数： void SysTickCfg_SuspendTick(void)
//////功	   能： 系统滴答定时器挂起
//////输入参数: 无
//////输出参数: 无
//////说	   明： 系统滴答定时器中断不使能
//////////////////////////////////////////////////////////////////////////////
void SysTickCfg_SuspendTick(void)
{
	//---不使能系统滴答定时器的中断
	SysTick->CTRL &= ~SysTick_CTRL_TICKINT_Msk;
}

///////////////////////////////////////////////////////////////////////////////
//////函	   数： void SysTickCfg_ResumeTick(void)
//////功	   能： 系统滴答定时器恢复
//////输入参数: 无
//////输出参数: 无
//////说	   明： 系统滴答定时器中断使能
//////////////////////////////////////////////////////////////////////////////
void SysTickCfg_ResumeTick(void)
{
	//---使能系统滴答定时器的中断
	SysTick->CTRL |= SysTick_CTRL_TICKINT_Msk;
}

///////////////////////////////////////////////////////////////////////////////
//////函	   数： void SysTickCfg_Init(void)
//////功	   能： 系统滴答定时器的配置
//////输入参数: 无
//////输出参数: 无
//////说	   明： 
//////////////////////////////////////////////////////////////////////////////
void SysTickCfg_Init(void)
{
	//---产生100us的时间滴答器---该初始化函数没有注册中断
	LL_InitTick(SystemCoreClock, SYSTICK_BASE_TIME_COUNT/*10000U*/);
	//---设置中断抢占分组
	NVIC_SetPriorityGrouping(NVIC_PRIORITYGROUP_4);
	//---配置滴答定时器中断---设置为最低优先级
	NVIC_SetPriority(SysTick_IRQn, NVIC_EncodePriority(NVIC_GetPriorityGrouping( ), SYSTICK_IRQ_PP_VAL, SYSTICK_IRQ_SP_VAL));
	//---注册滴答定时器中断
	NVIC_EnableIRQ(SysTick_IRQn);
	//---使能滴答定时的中断
	SysTickCfg_ResumeTick( );
}

///////////////////////////////////////////////////////////////////////////////
//////函	   数： void SysTickCfg_Init(void)
//////功	   能： 系统滴答定时器的配置
//////输入参数: 无
//////输出参数: 无
//////说	   明： 
//////////////////////////////////////////////////////////////////////////////
void SysTickCfg_Config(UINT32_T clkFreq,UINT32_T ticks)
{
	//---设置系统时钟
	LL_SetSystemCoreClock(clkFreq);
	//---产生100us的时间滴答器---该初始化函数没有使能滴答定时器的中断
	LL_InitTick(SystemCoreClock, ticks);
	//---设置中断抢占分组
	NVIC_SetPriorityGrouping(NVIC_PRIORITYGROUP_4);
	//---配置滴答定时器中断---设置为最低优先级
	NVIC_SetPriority(SysTick_IRQn, NVIC_EncodePriority(NVIC_GetPriorityGrouping( ), SYSTICK_IRQ_PP_VAL, SYSTICK_IRQ_SP_VAL));
	//---注册滴答定时器中断
	NVIC_EnableIRQ(SysTick_IRQn);
	//---使能滴答定时的中断
	SysTickCfg_ResumeTick( );
}

///////////////////////////////////////////////////////////////////////////////
//////函	   数： void SysTickCfg_IncInit(void) 
//////功	   能： 滴答定时器产生的定时节拍
//////输入参数: 无
//////输出参数: 无
//////说	   明： 
//////////////////////////////////////////////////////////////////////////////
void SysTickCfg_IncInit(void)
{
	//---100us的节拍
	pSysTick->usXBaseCount++;
	LL_GPIO_TogglePin( GPIOC, LL_GPIO_PIN_8 );
	//---1ms的节拍
	if ( ( ( pSysTick->usXBaseCount % SYSTICK_BASE_TIME_MS/*10*/ ) == 0 ) && ( pSysTick->usXBaseCount != 0 ) )
	{
		pSysTick->msX1Count++;
		LL_GPIO_TogglePin( GPIOC, LL_GPIO_PIN_9 );
	}
	//---10ms的节拍
	if ( ( ( pSysTick->usXBaseCount % SYSTICK_BASE_TIME_10MS/*100*/ ) == 0 ) && ( pSysTick->usXBaseCount != 0 ) )
	{
		pSysTick->msX10Count++;
	}
	//---100ms的节拍
	if ( ( ( pSysTick->usXBaseCount % SYSTICK_BASE_TIME_100MS/*1000*/ ) == 0 ) && ( pSysTick->usXBaseCount != 0 ) )
	{
		pSysTick->msX100Count++;
	}
	//---1s的节拍
	if( ( ( pSysTick->usXBaseCount % SYSTICK_BASE_TIME_S/*10000*/ ) == 0 ) && ( pSysTick->usXBaseCount != 0 ) )
	{
		pSysTick->sX1Count++;
		LED_Work_Change();
	}
}

///////////////////////////////////////////////////////////////////////////////
//////函	   数： 
//////功	   能： 
//////输入参数: 
//////输出参数: 
//////说	   明： 
//////////////////////////////////////////////////////////////////////////////
void SysTickCfg_DecInit(void)
{
	if ( pSysTick->usXBaseNum != 0 )
	{
		pSysTick->usXBaseNum--;
	}
}

///////////////////////////////////////////////////////////////////////////////
//////函	   数： 
//////功	   能： 
//////输入参数: 
//////输出参数: 
//////说	   明： 
//////////////////////////////////////////////////////////////////////////////
UINT32_T SysTickCfg_GetUsX100Val(void)
{
	return pSysTick->usXBaseCount;
}

///////////////////////////////////////////////////////////////////////////////
//////函	   数： 
//////功	   能： 
//////输入参数: 
//////输出参数: 
//////说	   明： 
//////////////////////////////////////////////////////////////////////////////
UINT32_T SysTickCfg_GetMsX1Val(void)
{
	return pSysTick->msX1Count;
}

///////////////////////////////////////////////////////////////////////////////
//////函	   数： 
//////功	   能： 
//////输入参数: 
//////输出参数: 
//////说	   明： 
//////////////////////////////////////////////////////////////////////////////
UINT32_T SysTickCfg_GetMsX10Val(void)
{
	return pSysTick->msX10Count;
}

///////////////////////////////////////////////////////////////////////////////
//////函	   数： 
//////功	   能： 
//////输入参数: 
//////输出参数: 
//////说	   明： 
//////////////////////////////////////////////////////////////////////////////
UINT32_T SysTickCfg_GetMsX100Val(void)
{
	return pSysTick->msX100Count;
}

///////////////////////////////////////////////////////////////////////////////
//////函	   数： 
//////功	   能： 
//////输入参数: 
//////输出参数: 
//////说	   明： 
//////////////////////////////////////////////////////////////////////////////
UINT32_T SysTickCfg_GetSX1Val(void)
{
	return pSysTick->sX1Count;
}

///////////////////////////////////////////////////////////////////////////////
//////函	   数： 
//////功	   能： 
//////输入参数: 
//////输出参数: 
//////说	   明： 
//////////////////////////////////////////////////////////////////////////////
void SysTickCfg_SetUsX100(UINT32_T us)
{
	pSysTick->usXBaseNum = us;
}

///////////////////////////////////////////////////////////////////////////////
//////函	   数： 
//////功	   能： 
//////输入参数: 
//////输出参数: 
//////说	   明： 
//////////////////////////////////////////////////////////////////////////////
UINT32_T SysTickCfg_GetUsX100(void)
{
	return pSysTick->usXBaseNum;
}

///////////////////////////////////////////////////////////////////////////////
//////函	   数： 
//////功	   能： 
//////输入参数: 
//////输出参数: 
//////说	   明： 
//////////////////////////////////////////////////////////////////////////////
void SysTickCfg_IRQHandler(void)
{
	SysTickCfg_DecInit( );
	SysTickCfg_IncInit( );
}

///////////////////////////////////////////////////////////////////////////////
//////函	   数：
//////功	   能：
//////输入参数: 
//////输出参数: 
//////说	   明：
//////////////////////////////////////////////////////////////////////////////
void SysTickCfg_GetSysTick( UINT32_T *ctrlVal,UINT32_T *loadVal )
{
	//---保存定时器的配置信息
	*ctrlVal= SysTick->CTRL;
	//---计数重新装载值
	*loadVal= SysTick->LOAD;
	//---关闭定时器，时钟选择为系统时钟，不进行8分频
	SysTick->CTRL = 0x00000004;
}
///////////////////////////////////////////////////////////////////////////////
//////函	   数：
//////功	   能：
//////输入参数: 
//////输出参数: 
//////说	   明：
//////////////////////////////////////////////////////////////////////////////
void SysTickCfg_WaitSysTick(UINT32_T us)
{
	//---计算装载值
	SysTick->LOAD = us;
	//---清零计数器
	SysTick->VAL = 0x00;
	//---使能计数器计数
	SysTick->CTRL |= 0x01;
	//---等待计数到0
	while ( !( SysTick->CTRL & 0x00010000 ) );
}

///////////////////////////////////////////////////////////////////////////////
//////函	   数：
//////功	   能：
//////输入参数: 
//////输出参数: 
//////说	   明：
//////////////////////////////////////////////////////////////////////////////
void SysTickCfg_ReSetSysTick( UINT32_T ctrlVal , UINT32_T loadVal )
{
	//---关闭定时器，时钟选择为系统时钟，不进行8分频
	SysTick->CTRL = 0x00000004;
	//---恢复初始值
	SysTick->LOAD = loadVal;
	//---清零计数器
	SysTick->VAL = 0x00;
	//---恢复计数器的配置
	SysTick->CTRL = ctrlVal;
}
